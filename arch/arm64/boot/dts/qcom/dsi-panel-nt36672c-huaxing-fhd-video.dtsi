/* Copyright (c) 2017-2018, The Linux Foundation. All rights reserved.
 *
 * This program is free software; you can redistribute it and/or modify
 * it under the terms of the GNU General Public License version 2 and
 * only version 2 as published by the Free Software Foundation.
 *
 * This program is distributed in the hope that it will be useful,
 * but WITHOUT ANY WARRANTY; without even the implied warranty of
 * MERCHANTABILITY or FITNESS FOR A PARTICULAR PURPOSE.  See the
 * GNU General Public License for more details.
 */

&mdss_mdp {
	dsi_nt36672c_huaxing_fhd_video: qcom,mdss_dsi_nt36672c_huaxing_fhd_video {
		qcom,mdss-dsi-panel-name = "nt36672c huaxing fhd video mode dsi panel";
		qcom,mdss-dsi-panel-id = <0>;
		qcom,mdss-dsi-panel-type = "dsi_video_mode";
		qcom,mdss-dsi-virtual-channel-id = <0>;
		qcom,mdss-dsi-stream = <0>;
		qcom,mdss-dsi-bpp = <24>;
		qcom,mdss-dsi-color-order = "rgb_swap_rgb";
		qcom,mdss-dsi-underflow-color = <0xff>;
		qcom,mdss-dsi-border-color = <0>;
		qcom,mdss-dsi-traffic-mode = "non_burst_sync_event";
		qcom,mdss-dsi-bllp-eof-power-mode;
		qcom,mdss-dsi-bllp-power-mode;
		qcom,mdss-dsi-lp11-init;
		qcom,mdss-dsi-lane-0-state;
		qcom,mdss-dsi-lane-1-state;
		qcom,mdss-dsi-lane-2-state;
		qcom,mdss-dsi-lane-3-state;
		qcom,mdss-brightness-max-level = <4095>;
		qcom,mdss-dsi-dma-trigger = "trigger_sw";
		qcom,mdss-dsi-mdp-trigger = "none";
		qcom,mdss-dsi-reset-sequence = <1 3>, <0 5>, <1 10>;
		qcom,mdss-pan-physical-width-dimension = <70>;
		qcom,mdss-pan-physical-height-dimension = <154>;
		qcom,cont-splash-enabled;
		qcom,mdss-dsi-tx-eot-append;
		qcom,dispparam-enabled;
		qcom,mdss-dsi-panel-hdr-enabled;
		qcom,mdss-dsi-panel-hdr-color-primaries = <14500 15500 32000
			17000 15500 30000 8000 3000>;
		qcom,mdss-dsi-panel-peak-brightness = <4200000>;
		qcom,mdss-dsi-panel-blackness-level = <3230>;
		qcom,mdss-dsi-bl-pmic-control-type = "bl_ctrl_wled";
		qcom,mdss-dsi-bl-min-level = <1>;
		qcom,mdss-dsi-bl-max-level = <4095>;
		qcom,mdss-dsi-post-init-delay = <1>;
		qcom,mdss-dsi-qsync-min-refresh-rate = <30>;
		qcom,mdss-dsi-pan-enable-dynamic-fps;
		qcom,mdss-dsi-pan-enable-smart-fps;
		qcom,mdss-dsi-pan-fps-update =
			"dfps_immediate_porch_mode_vfp";
		qcom,dsi-supported-dfps-list = <120 90 60 50 30>;

		qcom,mdss-dsi-display-timings {
			timing@0{
				qcom,mdss-dsi-panel-width = <1080>;
				qcom,mdss-dsi-panel-height = <2400>;
				qcom,mdss-dsi-h-front-porch = <73>;
				qcom,mdss-dsi-h-back-porch = <40>;
				qcom,mdss-dsi-h-pulse-width = <12>;
				qcom,mdss-dsi-h-sync-skew = <0>;
				qcom,mdss-dsi-h-sync-pulse = <0>;
				qcom,mdss-dsi-v-back-porch = <30>;
				qcom,mdss-dsi-v-front-porch = <32>;
				qcom,mdss-dsi-v-pulse-width = <2>;
				qcom,mdss-dsi-panel-framerate = <120>;
				qcom,mdss-dsi-h-left-border = <0>;
				qcom,mdss-dsi-h-right-border = <0>;
				qcom,mdss-dsi-v-top-border = <0>;
				qcom,mdss-dsi-v-bottom-border = <0>;

				qcom,mdss-dsi-on-command = [
					15 01 00 00 00 00 02 FF 10
					15 01 00 00 00 00 02 FB 01
					15 01 00 00 00 00 02 B0 00
					15 01 00 00 00 00 11 C1 89 28 00 14 02 00 02 0E 01 E8 00 07 05 0E 05 16
					15 01 00 00 00 00 03 C2 10 F0

					15 01 00 00 00 00 02 FF 20
					15 01 00 00 00 00 02 FB 01
					15 01 00 00 00 00 02 01 66
					15 01 00 00 00 00 02 06 64
					15 01 00 00 00 00 02 07 28
					15 01 00 00 00 00 02 1B 01
					15 01 00 00 00 00 02 1F 80
					15 01 00 00 00 00 02 20 C0
					15 01 00 00 00 00 02 5F 80
					15 01 00 00 00 00 02 60 C0
					15 01 00 00 00 00 02 69 D0
					15 01 00 00 00 00 02 95 D1
					15 01 00 00 00 00 02 96 D1
					15 01 00 00 00 00 02 EE 60
					15 01 00 00 00 00 02 EF 06
					15 01 00 00 00 00 02 F2 64
					15 01 00 00 00 00 02 F4 64
					15 01 00 00 00 00 02 F6 64
					15 01 00 00 00 00 02 F8 64

					15 01 00 00 00 00 02 FF 24
					15 01 00 00 00 00 02 FB 01
					15 01 00 00 00 00 02 01 10
					15 01 00 00 00 00 02 02 24
					15 01 00 00 00 00 02 04 01
					15 01 00 00 00 00 02 06 0B
					15 01 00 00 00 00 02 08 0C
					15 01 00 00 00 00 02 0A 0F
					15 01 00 00 00 00 02 0B 22
					15 01 00 00 00 00 02 0D 2C
					15 01 00 00 00 00 02 0E 2E
					15 01 00 00 00 00 02 0F 30
					15 01 00 00 00 00 02 10 32
					15 01 00 00 00 00 02 12 28
					15 01 00 00 00 00 02 13 17
					15 01 00 00 00 00 02 14 27
					15 01 00 00 00 00 02 15 15
					15 01 00 00 00 00 02 16 26
					15 01 00 00 00 00 02 17 13
					15 01 00 00 00 00 02 19 10
					15 01 00 00 00 00 02 1A 24
					15 01 00 00 00 00 02 1C 01
					15 01 00 00 00 00 02 1E 0B
					15 01 00 00 00 00 02 20 0C
					15 01 00 00 00 00 02 22 0F
					15 01 00 00 00 00 02 23 22
					15 01 00 00 00 00 02 25 2D
					15 01 00 00 00 00 02 26 2F
					15 01 00 00 00 00 02 27 31
					15 01 00 00 00 00 02 28 33
					15 01 00 00 00 00 02 2A 28
					15 01 00 00 00 00 02 2B 17
					15 01 00 00 00 00 02 2D 27
					15 01 00 00 00 00 02 2F 15
					15 01 00 00 00 00 02 30 26
					15 01 00 00 00 00 02 31 13
					15 01 00 00 00 00 02 32 05
					15 01 00 00 00 00 02 33 03
					15 01 00 00 00 00 02 34 03
					15 01 00 00 00 00 02 35 01
					15 01 00 00 00 00 02 36 2F
					15 01 00 00 00 00 02 4D 01
					15 01 00 00 00 00 02 4E 34
					15 01 00 00 00 00 02 4F 34
					15 01 00 00 00 00 02 53 34
					15 01 00 00 00 00 02 77 80
					15 01 00 00 00 00 02 79 22
					15 01 00 00 00 00 02 7A 06
					15 01 00 00 00 00 02 7B 8C
					15 01 00 00 00 00 02 7D 03
					15 01 00 00 00 00 02 80 03
					15 01 00 00 00 00 02 81 03
					15 01 00 00 00 00 02 82 13
					15 01 00 00 00 00 02 84 31
					15 01 00 00 00 00 02 85 13
					15 01 00 00 00 00 02 86 22
					15 01 00 00 00 00 02 87 31
					15 01 00 00 00 00 02 90 13
					15 01 00 00 00 00 02 92 31
					15 01 00 00 00 00 02 93 13
					15 01 00 00 00 00 02 94 22
					15 01 00 00 00 00 02 95 31
					15 01 00 00 00 00 02 9C F4
					15 01 00 00 00 00 02 9D 01
					15 01 00 00 00 00 02 A0 0C
					15 01 00 00 00 00 02 A2 0C
					15 01 00 00 00 00 02 A3 06
					15 01 00 00 00 00 02 A4 03
					15 01 00 00 00 00 02 A5 03
					15 01 00 00 00 00 02 C4 80
					15 01 00 00 00 00 02 C6 C0
					15 01 00 00 00 00 02 C9 00
					15 01 00 00 00 00 02 CC 80
					15 01 00 00 00 00 02 D1 34
					15 01 00 00 00 00 02 D9 80
					15 01 00 00 00 00 02 E9 06

					15 01 00 00 00 00 02 FF 25
					15 01 00 00 00 00 02 FB 01
					15 01 00 00 00 00 02 19 E4
					15 01 00 00 00 00 02 63 8F
					15 01 00 00 00 00 02 66 5D
					15 01 00 00 00 00 02 67 13
					15 01 00 00 00 00 02 68 58
					15 01 00 00 00 00 02 69 10
					15 01 00 00 00 00 02 6B 00
					15 01 00 00 00 00 02 70 E5
					15 01 00 00 00 00 02 71 6D
					15 01 00 00 00 00 02 77 72
					15 01 00 00 00 00 02 7E 2D
					15 01 00 00 00 00 02 81 00
					15 01 00 00 00 00 02 84 78
					15 01 00 00 00 00 02 85 75
					15 01 00 00 00 00 02 8D 00
					15 01 00 00 00 00 02 C1 A9
					15 01 00 00 00 00 02 C3 07
					15 01 00 00 00 00 02 C4 11
					15 01 00 00 00 00 02 F0 05
					15 01 00 00 00 00 02 F1 14

					15 01 00 00 00 00 02 FF 26
					15 01 00 00 00 00 02 FB 01
					15 01 00 00 00 00 02 00 10
					15 01 00 00 00 00 02 01 E8
					15 01 00 00 00 00 02 03 00
					15 01 00 00 00 00 02 04 EA
					15 01 00 00 00 00 02 05 08
					15 01 00 00 00 00 02 06 11
					15 01 00 00 00 00 02 08 0F
					15 01 00 00 00 00 02 14 02
					15 01 00 00 00 00 02 15 01
					15 01 00 00 00 00 02 74 AF
					15 01 00 00 00 00 02 81 0C
					15 01 00 00 00 00 02 83 06
					15 01 00 00 00 00 02 84 02
					15 01 00 00 00 00 02 85 01
					15 01 00 00 00 00 02 86 02
					15 01 00 00 00 00 02 87 01
					15 01 00 00 00 00 02 88 06
					15 01 00 00 00 00 02 8A 1A
					15 01 00 00 00 00 02 8B 11
					15 01 00 00 00 00 02 8C 24
					15 01 00 00 00 00 02 8E 42
					15 01 00 00 00 00 02 8F 11
					15 01 00 00 00 00 02 90 11
					15 01 00 00 00 00 02 91 11
					15 01 00 00 00 00 02 9A 80
					15 01 00 00 00 00 02 9B 04
					15 01 00 00 00 00 02 9C 00
					15 01 00 00 00 00 02 9D 00
					15 01 00 00 00 00 02 9E 00

					15 01 00 00 00 00 02 FF 27
					15 01 00 00 00 00 02 FB 01
					15 01 00 00 00 00 02 01 60
					15 01 00 00 00 00 02 20 81
					15 01 00 00 00 00 02 21 71
					15 01 00 00 00 00 02 25 81
					15 01 00 00 00 00 02 26 99
					15 01 00 00 00 00 02 6E 12
					15 01 00 00 00 00 02 6F 00
					15 01 00 00 00 00 02 70 00
					15 01 00 00 00 00 02 71 00
					15 01 00 00 00 00 02 72 00
					15 01 00 00 00 00 02 73 76
					15 01 00 00 00 00 02 74 10
					15 01 00 00 00 00 02 75 32
					15 01 00 00 00 00 02 76 54
					15 01 00 00 00 00 02 77 00
					15 01 00 00 00 00 02 7D 09
					15 01 00 00 00 00 02 7E 63
					15 01 00 00 00 00 02 80 27
					15 01 00 00 00 00 02 82 09
					15 01 00 00 00 00 02 83 63
					15 01 00 00 00 00 02 88 03
					15 01 00 00 00 00 02 89 03

					15 01 00 00 00 00 02 FF 2A
					15 01 00 00 00 00 02 FB 01
					15 01 00 00 00 00 02 00 D1
					15 01 00 00 00 00 02 03 20
					15 01 00 00 00 00 02 07 56
					15 01 00 00 00 00 02 0A 70
					15 01 00 00 00 00 02 0C 09
					15 01 00 00 00 00 02 0D 40
					15 01 00 00 00 00 02 0E 02
					15 01 00 00 00 00 02 0F 00
					15 01 00 00 00 00 02 11 F0
					15 01 00 00 00 00 02 15 0E
					15 01 00 00 00 00 02 16 A8
					15 01 00 00 00 00 02 19 0E
					15 01 00 00 00 00 02 1A 7C
					15 01 00 00 00 00 02 1E 38
					15 01 00 00 00 00 02 1F 45
					15 01 00 00 00 00 02 20 38
					15 01 00 00 00 00 02 27 80
					15 01 00 00 00 00 02 28 B2
					15 01 00 00 00 00 02 29 1D
					15 01 00 00 00 00 02 2A 01
					15 01 00 00 00 00 02 2D 04
					15 01 00 00 00 00 02 2F 06
					15 01 00 00 00 00 02 31 42
					15 01 00 00 00 00 02 33 B0
					15 01 00 00 00 00 02 34 B4
					15 01 00 00 00 00 02 35 34
					15 01 00 00 00 00 02 36 C4
					15 01 00 00 00 00 02 37 AF
					15 01 00 00 00 00 02 38 38
					15 01 00 00 00 00 02 39 C0
					15 01 00 00 00 00 02 4A F0

					15 01 00 00 00 00 02 FF E0
					15 01 00 00 00 00 02 FB 01
					15 01 00 00 00 00 02 35 82

					15 01 00 00 00 00 02 FF F0
					15 01 00 00 00 00 02 FB 01
					15 01 00 00 00 00 02 5A 00
					15 01 00 00 00 00 02 9C 00
					15 01 00 00 00 00 02 BE 08

					15 01 00 00 00 00 02 FF C0
					15 01 00 00 00 00 02 FB 01
					15 01 00 00 00 00 02 9C 11
					15 01 00 00 00 00 02 9D 11

					15 01 00 00 00 00 02 FF 10

					15 01 00 00 00 00 02 51 B8
					15 01 00 00 00 00 02 53 2C
					15 01 00 00 00 00 02 55 00
					15 01 00 00 00 00 02 FF 27
					15 01 00 00 00 00 02 FB 01
					15 01 00 00 00 00 02 40 25
					15 01 00 00 00 00 02 FF 10
					15 01 00 00 00 00 02 FB 01
					05 01 00 00 64 00 02 11 00
					05 01 00 00 28 00 02 29 00
					15 01 00 00 00 00 02 FF 27
					15 01 00 00 00 00 02 FB 01
					15 01 00 00 00 00 02 3F 01
					15 01 00 00 00 00 02 43 00
				];
				qcom,mdss-dsi-off-command = [
					15 01 00 00 00 00 02 FF 10
					15 01 00 00 00 00 02 FB 01
					05 01 00 00 10 00 02 28 00
					05 01 00 00 3C 00 02 10 00
				];

				qcom,mdss-dsi-dispparam-cabcuion-command = [
					15 01 00 00 00 00 02 FF 23
					15 01 00 00 00 00 02 FB 01
					15 01 00 00 00 00 02 10 82
					15 01 00 00 00 00 02 11 01
					15 01 00 00 00 00 02 12 95
					15 01 00 00 00 00 02 15 68
					15 01 00 00 00 00 02 16 0B

					15 01 00 00 00 00 02 30 FF
					15 01 00 00 00 00 02 31 FD
					15 01 00 00 00 00 02 32 FB
					15 01 00 00 00 00 02 33 FA
					15 01 00 00 00 00 02 34 F9
					15 01 00 00 00 00 02 35 F7
					15 01 00 00 00 00 02 36 F5
					15 01 00 00 00 00 02 37 F4
					15 01 00 00 00 00 02 38 F1
					15 01 00 00 00 00 02 39 EF
					15 01 00 00 00 00 02 3A ED
					15 01 00 00 00 00 02 3B EB
					15 01 00 00 00 00 02 3D EA
					15 01 00 00 00 00 02 3F E8
					15 01 00 00 00 00 02 40 E6
					15 01 00 00 00 00 02 41 E5
				];
				qcom,mdss-dsi-dispparam-cabcmovieon-command = [
					15 01 00 00 00 00 02 FF 23
					15 01 00 00 00 00 02 FB 01
					15 01 00 00 00 00 02 10 82
					15 01 00 00 00 00 02 11 01
					15 01 00 00 00 00 02 12 95
					15 01 00 00 00 00 02 15 68
					15 01 00 00 00 00 02 16 0B

					15 01 00 00 00 00 02 58 FF
					15 01 00 00 00 00 02 59 F8
					15 01 00 00 00 00 02 5A F3
					15 01 00 00 00 00 02 5B EE
					15 01 00 00 00 00 02 5C E9
					15 01 00 00 00 00 02 5D E4
					15 01 00 00 00 00 02 5E DF
					15 01 00 00 00 00 02 5F DA
					15 01 00 00 00 00 02 60 D4
					15 01 00 00 00 00 02 61 CF
					15 01 00 00 00 00 02 62 CA
					15 01 00 00 00 00 02 63 C5
					15 01 00 00 00 00 02 64 C0
					15 01 00 00 00 00 02 65 BB
					15 01 00 00 00 00 02 66 B6
					15 01 00 00 00 00 02 67 B1
					15 01 00 00 00 00 02 A0 11
				];
				qcom,mdss-dsi-dispparam-cabcstillon-command = [
					15 01 00 00 00 00 02 FF 23
					15 01 00 00 00 00 02 FB 01
					15 01 00 00 00 00 02 10 82
					15 01 00 00 00 00 02 11 01
					15 01 00 00 00 00 02 12 95
					15 01 00 00 00 00 02 15 68
					15 01 00 00 00 00 02 16 0B

					15 01 00 00 00 00 02 45 FF
					15 01 00 00 00 00 02 46 F3
					15 01 00 00 00 00 02 47 E8
					15 01 00 00 00 00 02 48 DD
					15 01 00 00 00 00 02 49 D3
					15 01 00 00 00 00 02 4A C9
					15 01 00 00 00 00 02 4B BE
					15 01 00 00 00 00 02 4C B3
					15 01 00 00 00 00 02 4D A9
					15 01 00 00 00 00 02 4E 9F
					15 01 00 00 00 00 02 4F 95
					15 01 00 00 00 00 02 50 8B
					15 01 00 00 00 00 02 51 81
					15 01 00 00 00 00 02 52 77
					15 01 00 00 00 00 02 53 6D
					15 01 00 00 00 00 02 54 65
				];
				qcom,mdss-dsi-dispparam-cabcoff-command = [
					15 01 00 00 00 00 02 FF 10
					15 01 00 00 00 00 02 FB 01
					15 01 00 00 00 00 02 53 2C
					15 01 00 00 00 00 02 55 00
				];
				qcom,mdss-dsi-dispparam-lcd-hbm-l1-on-command = [
					15 01 00 00 00 00 02 51 E6
				];
				qcom,mdss-dsi-dispparam-lcd-hbm-l2-on-command = [
					15 01 00 00 00 00 02 51 FF
				];
				qcom,mdss-dsi-dispparam-lcd-hbm-off-command = [
					15 01 00 00 00 00 02 51 B8
				];
				qcom,mdss-dsi-dispparam-hbm-on-command = [
					15 01 00 00 00 00 02 51 E6
				];
				qcom,mdss-dsi-dispparam-hbm-off-command = [
					15 01 00 00 00 00 02 51 B8
				];
				qcom,mdss-dsi-hbm1-on-command = [
					15 01 00 00 00 00 02 51 E6
				];
				qcom,mdss-dsi-hbm2-on-command = [
					15 01 00 00 00 00 02 51 FF
				];

				qcom,mdss-dsi-on-command-state = "dsi_lp_mode";
				qcom,mdss-dsi-off-command-state = "dsi_lp_mode";

				qcom,mdss-dsi-dispparam-cabcuion-command-state = "dsi_hs_mode";
				qcom,mdss-dsi-dispparam-cabcstillon-command-state = "dsi_hs_mode";
				qcom,mdss-dsi-dispparam-cabcmovieon-command-state = "dsi_hs_mode";
				qcom,mdss-dsi-dispparam-cabcoff-command-state = "dsi_hs_mode";

				qcom,mdss-dsi-dispparam-lcd-hbm-l1-on-command-state = "dsi_lp_mode";
				qcom,mdss-dsi-dispparam-lcd-hbm-l2-on-command-state = "dsi_lp_mode";
				qcom,mdss-dsi-dispparam-lcd-hbm-off-command-state = "dsi_lp_mode";

				qcom,mdss-dsi-dispparam-hbm-on-command-state = "dsi_lp_mode";
				qcom,mdss-dsi-hbm1-on-command-state = "dsi_lp_mode";
				qcom,mdss-dsi-hbm2-on-command-state = "dsi_lp_mode";
				qcom,mdss-dsi-dispparam-hbm-off-command-state = "dsi_lp_mode";




				//delay dimming on
				qcom,mdss-dsi-dispparam-dimmingon-command = [39 01 00 00 01 00 02 53 2C];
				qcom,mdss-dsi-dispparam-dimmingon-command-state = "dsi_lp_mode";
				qcom,mdss-dsi-dispparam-dimmingoff-command = [39 01 00 00 01 00 02 53 24];
				qcom,mdss-dsi-dispparam-dimmingoff-command-state = "dsi_lp_mode";

				//coordinate
				qcom,mdss-dsi-panel-xy-coordinate = <0x0F 0x18>;
				qcom,mdss-dsi-dispparam-xy-coordinate-command = [
					15 01 00 00 00 00 02 FF 20
					06 01 00 01 05 00 02 A1 00
				];
				qcom,mdss-dsi-dispparam-xy-coordinate-command-state = "dsi_hs_mode";

				qcom,compression-mode = "dsc";
				qcom,mdss-dsc-version = <0x11>;
				qcom,mdss-dsc-scr-version = <0x0>;
				qcom,mdss-dsc-encoders = <1>;
				qcom,mdss-dsc-slice-height = <20>;
				qcom,mdss-dsc-slice-width = <540>;
				qcom,mdss-dsc-slice-per-pkt = <2>;
				qcom,mdss-dsc-bit-per-component = <8>;
				qcom,mdss-dsc-bit-per-pixel = <8>;
				qcom,mdss-dsc-block-prediction-enable;
			};
		};
	};
};
