/* Copyright (c) 2017-2018, The Linux Foundation. All rights reserved.
 *
 * This program is free software; you can redistribute it and/or modify
 * it under the terms of the GNU General Public License version 2 and
 * only version 2 as published by the Free Software Foundation.
 *
 * This program is distributed in the hope that it will be useful,
 * but WITHOUT ANY WARRANTY; without even the implied warranty of
 * MERCHANTABILITY or FITNESS FOR A PARTICULAR PURPOSE.  See the
 * GNU General Public License for more details.
 */

&mdss_mdp {
	dsi_nt36672c_tianma_fhd_video: qcom,mdss_dsi_nt36672c_tianma_fhd_video {
		qcom,mdss-dsi-panel-name =
				"nt36672c tianma fhd video mode dsi panel";
		qcom,mdss-dsi-panel-type = "dsi_video_mode";
		qcom,mdss-dsi-virtual-channel-id = <0>;
		qcom,mdss-dsi-stream = <0>;
		qcom,mdss-dsi-h-left-border = <0>;
		qcom,mdss-dsi-h-right-border = <0>;
		qcom,mdss-dsi-v-top-border = <0>;
		qcom,mdss-dsi-v-bottom-border = <0>;
		qcom,mdss-dsi-bpp = <24>;
		qcom,mdss-dsi-underflow-color = <0xff>;
		qcom,mdss-dsi-border-color = <0>;
		qcom,mdss-dsi-traffic-mode = "non_burst_sync_event";
		qcom,mdss-dsi-bllp-eof-power-mode;
		qcom,mdss-dsi-bllp-power-mode;
		qcom,mdss-dsi-lane-0-state;
		qcom,mdss-dsi-lane-1-state;
		qcom,mdss-dsi-lane-2-state;
		qcom,mdss-dsi-lane-3-state;
		qcom,mdss-dsi-dma-trigger = "trigger_sw";
		qcom,mdss-dsi-mdp-trigger = "none";
		qcom,mdss-dsi-reset-sequence = <1 10>, <0 10>, <1 10>;
		qcom,mdss-dsi-tx-eot-append;
		qcom,mdss-dsi-post-init-delay = <1>;
		qcom,mdss-pan-physical-width-dimension = <69>;
		qcom,mdss-pan-physical-height-dimension = <154>;

		qcom,mdss-dsi-display-timings {
			timing@0{
				qcom,mdss-dsi-panel-width = <1080>;
				qcom,mdss-dsi-panel-height = <2400>;
				qcom,mdss-dsi-h-front-porch = <60>;
				qcom,mdss-dsi-h-back-porch = <40>;
				qcom,mdss-dsi-h-pulse-width = <20>;
				qcom,mdss-dsi-h-sync-skew = <0>;
				qcom,mdss-dsi-h-sync-pulse = <0>;
				qcom,mdss-dsi-v-back-porch = <28>;
				qcom,mdss-dsi-v-front-porch = <32>;
				qcom,mdss-dsi-v-pulse-width = <4>;
				qcom,mdss-dsi-panel-framerate = <120>;
				qcom,mdss-dsi-h-left-border = <0>;
				qcom,mdss-dsi-h-right-border = <0>;
				qcom,mdss-dsi-v-top-border = <0>;
				qcom,mdss-dsi-v-bottom-border = <0>;
				qcom,mdss-dsi-on-command =
					[29 01 00 00 00 00 02 FF 20
					29 01 00 00 00 00 02 FB 01
					29 01 00 00 00 00 02 F2 65
					29 01 00 00 00 00 02 F3 54
					29 01 00 00 00 00 02 F4 65
					29 01 00 00 00 00 02 F5 54
					29 01 00 00 00 00 02 F6 65
					29 01 00 00 00 00 02 F7 54
					29 01 00 00 00 00 02 F8 65
					29 01 00 00 00 00 02 F9 54

					29 01 00 00 00 00 02 FF 24
					29 01 00 00 00 00 02 FB 01
					29 01 00 00 00 00 02 06 8B
					29 01 00 00 00 00 02 07 8C
					29 01 00 00 00 00 02 1E 8B
					29 01 00 00 00 00 02 1F 8C
					29 01 00 00 00 00 02 4D 03
					29 01 00 00 00 00 02 4E 33
					29 01 00 00 00 00 02 4F 33
					29 01 00 00 00 00 02 53 33
					29 01 00 00 00 00 02 7A 03
					29 01 00 00 00 00 02 7B 8D
					29 01 00 00 00 00 02 A0 0D
					29 01 00 00 00 00 02 A2 0D
					29 01 00 00 00 00 02 A3 03
					29 01 00 00 00 00 02 E9 03

					29 01 00 00 00 00 02 FF 25
					29 01 00 00 00 00 02 FB 01
					29 01 00 00 00 00 02 66 40
					29 01 00 00 00 00 02 67 29
					29 01 00 00 00 00 02 79 7A
					29 01 00 00 00 00 02 DA 02
					29 01 00 00 00 00 02 E0 02
					29 01 00 00 00 00 02 F0 00
					29 01 00 00 00 00 02 F1 44

					29 01 00 00 00 00 02 FF 26
					29 01 00 00 00 00 02 FB 01
					29 01 00 00 00 00 02 01 EA
					29 01 00 00 00 00 02 04 EA
					29 01 00 00 00 00 02 05 08
					29 01 00 00 00 00 02 06 0F
					29 01 00 00 00 00 02 08 0F
					29 01 00 00 00 00 02 81 0D
					29 01 00 00 00 00 02 83 03
					29 01 00 00 00 00 02 88 03

					29 01 00 00 00 00 02 FF 2A
					29 01 00 00 00 00 02 FB 01
					29 01 00 00 00 00 02 07 56
					29 01 00 00 00 00 02 0C 09
					29 01 00 00 00 00 02 0D 40
					29 01 00 00 00 00 02 0E 02
					29 01 00 00 00 00 02 0F 00
					29 01 00 00 00 00 02 11 F0
					29 01 00 00 00 00 02 16 A8
					29 01 00 00 00 00 02 1A 7C
					29 01 00 00 00 00 02 1E 38
					29 01 00 00 00 00 02 1F 38
					29 01 00 00 00 00 02 20 38
					29 01 00 00 00 00 02 28 B2
					29 01 00 00 00 00 02 29 1D
					29 01 00 00 00 00 02 2A 01
					29 01 00 00 00 00 02 2B 03
					29 01 00 00 00 00 02 2D 04
					29 01 00 00 00 00 02 2F 06
					29 01 00 00 00 00 02 30 1E
					29 01 00 00 00 00 02 31 64
					29 01 00 00 00 00 02 33 D8
					29 01 00 00 00 00 02 34 B4
					29 01 00 00 00 00 02 35 34
					29 01 00 00 00 00 02 36 C4
					29 01 00 00 00 00 02 37 AF
					29 01 00 00 00 00 02 38 38
					29 01 00 00 00 00 02 39 C0
					29 01 00 00 00 00 02 3A 1E
					29 01 00 00 00 00 02 4F A8
					29 01 00 00 00 00 02 53 7C
					29 01 00 00 00 00 02 6F 2A
					29 01 00 00 00 00 02 70 86
					29 01 00 00 00 00 02 7B 40
					29 01 00 00 00 00 02 84 A8
					29 01 00 00 00 00 02 88 7C

					29 01 00 00 00 00 02 FF 2C
					29 01 00 00 00 00 02 FB 01
					29 01 00 00 00 00 02 00 03
					29 01 00 00 00 00 02 01 03
					29 01 00 00 00 00 02 02 03
					29 01 00 00 00 00 02 16 03
					29 01 00 00 00 00 02 30 EA
					29 01 00 00 00 00 02 33 EA
					29 01 00 00 00 00 02 4E 03
					29 01 00 00 00 00 02 4F 08
					29 01 00 00 00 00 02 53 03
					29 01 00 00 00 00 02 54 03
					29 01 00 00 00 00 02 55 03
					29 01 00 00 00 00 02 56 21
					29 01 00 00 00 00 02 58 21
					29 01 00 00 00 00 02 59 21
					29 01 00 00 00 00 02 6A 03
					29 01 00 00 00 00 02 82 EA
					29 01 00 00 00 00 02 85 EA
					29 01 00 00 00 00 02 9D 21
					29 01 00 00 00 00 02 9E 03
					29 01 00 00 00 00 02 9F 0F

					29 01 00 00 00 00 02 FF 25
					29 01 00 00 00 00 02 FB 01
					29 01 00 00 00 00 02 18 20
					29 01 00 00 00 00 02 FF F0
					29 01 00 00 00 00 02 FB 01
					29 01 00 00 00 00 02 5A 00
					29 01 00 00 00 00 02 9C 00
					29 01 00 00 00 00 02 FF C0
					29 01 00 00 00 00 02 FB 01
					29 01 00 00 00 00 02 9C 11
					29 01 00 00 00 00 02 9D 11
					29 01 00 00 00 00 02 FF E0
					29 01 00 00 00 00 02 FB 01
					29 01 00 00 00 00 02 35 82
					29 01 00 00 00 00 02 FF 10
					29 01 00 00 00 00 02 FB 01
					29 01 00 00 00 00 02 36 00
					29 01 00 00 00 00 06 3B 03 20 20 04 04
					29 01 00 00 00 00 02 B0 00
					29 01 00 00 00 00 03 C2 1B A0
					29 01 00 00 00 00 02 51 B8
					29 01 00 00 00 00 02 53 2C
					29 01 00 00 00 00 02 55 00

					29 01 00 00 00 00 02 FF 27
					29 01 00 00 00 00 02 FB 01
					29 01 00 00 00 00 02 40 25
					29 01 00 00 00 00 02 FF 10
					29 01 00 00 00 00 02 FB 01
					05 01 00 00 78 00 02 11 00
					05 01 00 00 32 00 02 29 00
					29 01 00 00 00 00 02 FF 27
					29 01 00 00 00 00 02 FB 01
					29 01 00 00 00 00 02 3F 01
					29 01 00 00 00 00 02 43 00
					29 01 00 00 00 00 02 FF 10
					29 01 00 00 00 00 02 FB 01];
				qcom,mdss-dsi-off-command =
					[05 01 00 00 32 00 02 28 00
					05 01 00 00 78 00 02 10 00];
				qcom,mdss-dsi-cabc-on-command = [
				];
				qcom,mdss-dsi-cabc-still-on-command = [
				];
				qcom,mdss-dsi-cabc-movie-on-command  = [
				];
				qcom,mdss-dsi-cabc-off-command = [
				];
				qcom,mdss-dsi-hbm1-on-command = [
				29 01 00 00 00 00 02 51 CC
				];
				qcom,mdss-dsi-hbm2-on-command = [
				29 01 00 00 00 00 02 51 E6
				];
				qcom,mdss-dsi-hbm3-on-command  = [
				29 01 00 00 00 00 02 51 FF
				];
				qcom,mdss-dsi-hbm-off-command = [
				29 01 00 00 00 00 02 51 B8
				];
				qcom,mdss-dsi-on-command-state = "dsi_lp_mode";
				qcom,mdss-dsi-off-command-state = "dsi_lp_mode";
				qcom,mdss-dsi-cabc-on-command-state = "dsi_hs_mode";
				qcom,mdss-dsi-cabc-still-on-command-state = "dsi_hs_mode";
				qcom,mdss-dsi-cabc-movie-on-command-state = "dsi_hs_mode";
				qcom,mdss-dsi-cabc-off-command-state = "dsi_hs_mode";
				qcom,mdss-dsi-hbm1-on-command-state = "dsi_hs_mode";
				qcom,mdss-dsi-hbm2-on-command-state = "dsi_hs_mode";
				qcom,mdss-dsi-hbm3-on-command-state = "dsi_hs_mode";
				qcom,mdss-dsi-hbm-off-command-state = "dsi_hs_mode";
				qcom,compression-mode = "dsc";
				qcom,mdss-dsc-encoders = <1>;
				qcom,mdss-dsc-slice-height = <20>;
				qcom,mdss-dsc-slice-width = <540>;
				qcom,mdss-dsc-slice-per-pkt = <1>;
				qcom,mdss-dsc-bit-per-component = <8>;
				qcom,mdss-dsc-bit-per-pixel = <8>;
				qcom,mdss-dsc-block-prediction-enable;
			};
		};
	};
};
